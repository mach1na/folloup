#include "topic_service.h"

#include <algorithm>
#include <array>
#include <cstdio>
#include <cstdlib>
#include <ctime>
#include <mutex>
#include <string>
#include <vector>

#include "cJSON.h"
#include "esp_log.h"
#include "storage_service.h"

namespace topic_service {
namespace {

constexpr const char* kTag = "TopicService";
constexpr const char* kTopicsFileName = "topics.json";
constexpr std::array<const char*, 3> kDefaultTopicNames = {"Home", "Car", "Shopping"};

std::mutex s_mutex;
Snapshot s_snapshot = {};
EventHandler s_event_handler = nullptr;
void* s_event_context = nullptr;

std::string JoinPath(const std::string& left, const std::string& right)
{
    if (left.empty()) {
        return right;
    }
    if (left.back() == '/') {
        return left + right;
    }
    return left + "/" + right;
}

std::string TrimWhitespace(const std::string& text)
{
    const size_t start = text.find_first_not_of(" \t\r\n");
    if (start == std::string::npos) {
        return {};
    }
    const size_t end = text.find_last_not_of(" \t\r\n");
    return text.substr(start, end - start + 1);
}

bool ReadTextFile(const std::string& path, std::string* out)
{
    if (out == nullptr) {
        return false;
    }
    FILE* file = std::fopen(path.c_str(), "rb");
    if (file == nullptr) {
        return false;
    }
    if (std::fseek(file, 0, SEEK_END) != 0) {
        std::fclose(file);
        return false;
    }
    const long size = std::ftell(file);
    if (size < 0 || std::fseek(file, 0, SEEK_SET) != 0) {
        std::fclose(file);
        return false;
    }
    std::string content(static_cast<size_t>(size), '\0');
    const size_t read = size == 0 ? 0 : std::fread(content.data(), 1, content.size(), file);
    std::fclose(file);
    if (read != content.size()) {
        return false;
    }
    *out = std::move(content);
    return true;
}

bool WriteTextFile(const std::string& path, const std::string& text)
{
    FILE* file = std::fopen(path.c_str(), "wb");
    if (file == nullptr) {
        return false;
    }
    const bool ok = text.empty() || std::fwrite(text.data(), 1, text.size(), file) == text.size();
    std::fclose(file);
    return ok;
}

// Ids are "t<n>"; generated by scanning the highest existing suffix rather than persisting a
// separate counter field, so there's one less thing in topics.json that can drift out of sync.
std::string GenerateNextId(const std::vector<Topic>& topics)
{
    long max_suffix = 0;
    for (const Topic& topic : topics) {
        if (topic.id.size() < 2 || topic.id[0] != 't') {
            continue;
        }
        char* end = nullptr;
        const long value = std::strtol(topic.id.c_str() + 1, &end, 10);
        if (end != nullptr && *end == '\0' && value > max_suffix) {
            max_suffix = value;
        }
    }
    return "t" + std::to_string(max_suffix + 1);
}

std::vector<Topic> BuildDefaultTopics()
{
    std::vector<Topic> topics;
    const int64_t now = static_cast<int64_t>(std::time(nullptr));
    int index = 1;
    for (const char* name : kDefaultTopicNames) {
        Topic topic;
        topic.id = "t" + std::to_string(index++);
        topic.name = name;
        topic.created_unix_seconds = now;
        topics.push_back(std::move(topic));
    }
    return topics;
}

std::string BuildRegistryJson(const std::vector<Topic>& topics)
{
    cJSON* root = cJSON_CreateObject();
    cJSON* array = cJSON_CreateArray();
    for (const Topic& topic : topics) {
        cJSON* item = cJSON_CreateObject();
        cJSON_AddStringToObject(item, "id", topic.id.c_str());
        cJSON_AddStringToObject(item, "name", topic.name.c_str());
        cJSON_AddNumberToObject(item, "created_unix_seconds",
                                static_cast<double>(topic.created_unix_seconds));
        cJSON_AddItemToArray(array, item);
    }
    cJSON_AddItemToObject(root, "topics", array);

    char* raw = cJSON_PrintUnformatted(root);
    std::string json = raw != nullptr ? raw : "";
    if (raw != nullptr) {
        cJSON_free(raw);
    }
    cJSON_Delete(root);
    return json;
}

// Returns false only when the JSON can't be parsed as a topic registry at all (missing/corrupt
// file). A registry that parses but is empty is a valid result (false is not "empty").
bool ParseRegistryJson(const std::string& json_text, std::vector<Topic>* topics_out)
{
    if (topics_out == nullptr) {
        return false;
    }
    cJSON* root = cJSON_ParseWithLength(json_text.c_str(), json_text.size());
    if (root == nullptr) {
        return false;
    }
    cJSON* array = cJSON_GetObjectItemCaseSensitive(root, "topics");
    if (!cJSON_IsArray(array)) {
        cJSON_Delete(root);
        return false;
    }

    std::vector<Topic> topics;
    cJSON* item = nullptr;
    cJSON_ArrayForEach(item, array)
    {
        cJSON* id = cJSON_GetObjectItemCaseSensitive(item, "id");
        cJSON* name = cJSON_GetObjectItemCaseSensitive(item, "name");
        if (!cJSON_IsString(id) || id->valuestring == nullptr || !cJSON_IsString(name) ||
            name->valuestring == nullptr) {
            continue;
        }
        Topic topic;
        topic.id = id->valuestring;
        topic.name = name->valuestring;
        cJSON* created = cJSON_GetObjectItemCaseSensitive(item, "created_unix_seconds");
        if (cJSON_IsNumber(created)) {
            topic.created_unix_seconds = static_cast<int64_t>(created->valuedouble);
        }
        topics.push_back(std::move(topic));
    }
    cJSON_Delete(root);
    *topics_out = std::move(topics);
    return true;
}

struct LoadContext {
    bool storage_available = false;
    bool loaded_from_file = false;
    std::vector<Topic> topics = {};
};

esp_err_t LoadRegistryOnMountedFilesystem(const char* mount_point, void* context)
{
    auto* ctx = static_cast<LoadContext*>(context);
    if (mount_point == nullptr || ctx == nullptr) {
        return ESP_ERR_INVALID_ARG;
    }
    ctx->storage_available = true;
    std::string text;
    const std::string path = JoinPath(mount_point, kTopicsFileName);
    if (ReadTextFile(path, &text) && ParseRegistryJson(text, &ctx->topics)) {
        ctx->loaded_from_file = true;
    }
    return ESP_OK;
}

struct SaveContext {
    const std::string* json = nullptr;
    bool saved = false;
};

esp_err_t SaveRegistryOnMountedFilesystem(const char* mount_point, void* context)
{
    auto* ctx = static_cast<SaveContext*>(context);
    if (mount_point == nullptr || ctx == nullptr || ctx->json == nullptr) {
        return ESP_ERR_INVALID_ARG;
    }
    const std::string path = JoinPath(mount_point, kTopicsFileName);
    ctx->saved = WriteTextFile(path, *ctx->json);
    return ctx->saved ? ESP_OK : ESP_FAIL;
}

bool PersistRegistry(const std::vector<Topic>& topics)
{
    const std::string json = BuildRegistryJson(topics);
    SaveContext ctx;
    ctx.json = &json;
    const esp_err_t err = storage_service::RunWithMountedFilesystem(SaveRegistryOnMountedFilesystem, &ctx);
    return err == ESP_OK && ctx.saved;
}

void NotifyHandler()
{
    EventHandler handler = nullptr;
    void* context = nullptr;
    Event event = {};
    {
        std::lock_guard<std::mutex> lock(s_mutex);
        handler = s_event_handler;
        context = s_event_context;
        event.snapshot = s_snapshot;
    }
    if (handler != nullptr) {
        handler(event, context);
    }
}

}  // namespace

esp_err_t Init()
{
    LoadContext ctx;
    const esp_err_t err = storage_service::RunWithMountedFilesystem(LoadRegistryOnMountedFilesystem, &ctx);

    std::vector<Topic> topics;
    bool needs_seed_write = false;
    const bool storage_available = err == ESP_OK && ctx.storage_available;
    if (storage_available) {
        if (ctx.loaded_from_file) {
            topics = std::move(ctx.topics);
        } else {
            topics = BuildDefaultTopics();
            needs_seed_write = true;
        }
    }

    {
        std::lock_guard<std::mutex> lock(s_mutex);
        s_snapshot.initialized = true;
        s_snapshot.storage_available = storage_available;
        s_snapshot.topics = topics;
    }

    if (needs_seed_write && !PersistRegistry(topics)) {
        ESP_LOGW(kTag, "Failed to persist seeded default topics");
    }

    ESP_LOGI(kTag, "Init: storage_available=%d topic_count=%d", storage_available ? 1 : 0,
             static_cast<int>(topics.size()));
    return err;
}

void SetEventHandler(EventHandler handler, void* context)
{
    std::lock_guard<std::mutex> lock(s_mutex);
    s_event_handler = handler;
    s_event_context = context;
}

Snapshot GetSnapshot()
{
    std::lock_guard<std::mutex> lock(s_mutex);
    return s_snapshot;
}

std::string Create(const std::string& name)
{
    const std::string trimmed = TrimWhitespace(name);
    if (trimmed.empty()) {
        return {};
    }

    std::string new_id;
    std::vector<Topic> topics_copy;
    {
        std::lock_guard<std::mutex> lock(s_mutex);
        if (!s_snapshot.storage_available) {
            return {};
        }
        new_id = GenerateNextId(s_snapshot.topics);
        Topic topic;
        topic.id = new_id;
        topic.name = trimmed;
        topic.created_unix_seconds = static_cast<int64_t>(std::time(nullptr));
        s_snapshot.topics.push_back(std::move(topic));
        topics_copy = s_snapshot.topics;
    }

    if (!PersistRegistry(topics_copy)) {
        std::lock_guard<std::mutex> lock(s_mutex);
        s_snapshot.topics.erase(
            std::remove_if(s_snapshot.topics.begin(), s_snapshot.topics.end(),
                           [&](const Topic& topic) { return topic.id == new_id; }),
            s_snapshot.topics.end());
        return {};
    }

    NotifyHandler();
    return new_id;
}

bool Rename(const std::string& id, const std::string& name)
{
    const std::string trimmed = TrimWhitespace(name);
    if (id.empty() || trimmed.empty()) {
        return false;
    }

    std::string previous_name;
    std::vector<Topic> topics_copy;
    {
        std::lock_guard<std::mutex> lock(s_mutex);
        if (!s_snapshot.storage_available) {
            return false;
        }
        auto it = std::find_if(s_snapshot.topics.begin(), s_snapshot.topics.end(),
                               [&](const Topic& topic) { return topic.id == id; });
        if (it == s_snapshot.topics.end()) {
            return false;
        }
        previous_name = it->name;
        it->name = trimmed;
        topics_copy = s_snapshot.topics;
    }

    if (!PersistRegistry(topics_copy)) {
        std::lock_guard<std::mutex> lock(s_mutex);
        auto it = std::find_if(s_snapshot.topics.begin(), s_snapshot.topics.end(),
                               [&](const Topic& topic) { return topic.id == id; });
        if (it != s_snapshot.topics.end()) {
            it->name = previous_name;
        }
        return false;
    }

    NotifyHandler();
    return true;
}

bool Delete(const std::string& id)
{
    if (id.empty()) {
        return false;
    }

    Topic removed;
    std::vector<Topic> topics_copy;
    {
        std::lock_guard<std::mutex> lock(s_mutex);
        if (!s_snapshot.storage_available) {
            return false;
        }
        auto it = std::find_if(s_snapshot.topics.begin(), s_snapshot.topics.end(),
                               [&](const Topic& topic) { return topic.id == id; });
        if (it == s_snapshot.topics.end()) {
            return false;
        }
        removed = *it;
        s_snapshot.topics.erase(it);
        topics_copy = s_snapshot.topics;
    }

    if (!PersistRegistry(topics_copy)) {
        std::lock_guard<std::mutex> lock(s_mutex);
        s_snapshot.topics.push_back(removed);
        return false;
    }

    NotifyHandler();
    return true;
}

}  // namespace topic_service
